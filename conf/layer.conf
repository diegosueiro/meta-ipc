## conf/layer.conf
```bitbake
# We have a conf and classes directory, add to BBPATH
BBPATH .= ":${LAYERDIR}"

# We have a packages directory, add to BBFILES
BBFILES += "${LAYERDIR}/recipes-*/*/*.bb \
            ${LAYERDIR}/recipes-*/*/*.bbappend"

BBFILE_COLLECTIONS += "meta-ipc"
BBFILE_PATTERN_meta-ipc := "^${LAYERDIR}/"
BBFILE_PRIORITY_meta-ipc = "10"

LAYERSERIES_COMPAT_meta-ipc = "sumo"
LAYERDEPENDS_meta-ipc = "core freescale-layer fsl-arm-extra"
```

## conf/machine/imx7s-warp.conf
```bitbake
#@TYPE: Machine
#@NAME: WaRP7
#@SOC: i.MX7S
#@DESCRIPTION: Machine configuration for i.MX7S WaRP board.
#@MAINTAINER: Pierre-Jean Texier <texier.pj2@gmail.com>

MACHINEOVERRIDES =. "mx7:mx7d:"

require conf/machine/include/imx-base.inc
require conf/machine/include/tune-cortexa7.inc
require conf/machine/include/zephyr.inc

MACHINE_FEATURES += " wifi bluetooth"

KERNEL_DEVICETREE = "imx7s-warp.dtb"

UBOOT_CONFIG ??= "sd"
UBOOT_CONFIG[sd] = "warp7_defconfig,sdcard"

MACHINE_ESSENTIAL_EXTRA_RDEPENDS += "zephyr-rpmsglite-bin"

MACHINE_EXTRA_RRECOMMENDS += "firmware-imx-brcm"

KERNEL_MODULE_AUTOLOAD += "g_ether imx_rpmsg_tty"

KERNEL_MODULE_PROBECONF += "g_ether"
module_conf_g_ether = "options g_ether host_addr=${USB_G_ETHER_HOST_MAC} dev_addr=${USB_G_ETHER_DEV_MAC}"
USB_G_ETHER_HOST_MAC ?= "4e:9d:24:0c:2b:95"
USB_G_ETHER_DEV_MAC ?= "c6:e3:cd:4f:d6:dc"
```

## conf/machine/include/zephyr.inc
```bitbake
ZEPHYR_BIN ?= "zephyr_rpmsg_tcm.bin"
IMAGE_BOOT_FILES_append += " ${ZEPHYR_BIN}"
```
